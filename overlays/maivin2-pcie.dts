// SPDX-License-Identifier: AGPL-3.0
/*
 * Copyright 2023 Au-Zone Technologies
 */

// Maivin 2 Overlays

/dts-v1/;
/plugin/;

#include <dt-bindings/clock/imx8mp-clock.h>
#include <dt-bindings/gpio/gpio.h>

#include "imx8mp-pinfunc.h"

/ {
	compatible = "toradex,verdin-imx8mp";
};

&m2_3v3 {
        regulator-always-on;
};

/* Verdin PCIE_1, for M.2 card slot */
&pcie {
	status = "okay";
};

&pcie_phy {
	status = "okay";
};